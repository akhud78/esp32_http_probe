## main/Kconfig.projbuild
```kconfig
menu "Project configuration"

    menu "LED setup"
        choice BLINK_LED
            prompt "Blink LED type"
            default BLINK_LED_GPIO
            help
                Defines the default peripheral for blink example

            config BLINK_LED_GPIO
                bool "GPIO"
            config BLINK_LED_RMT
                bool "RMT - Addressable LED"
        endchoice

        config BLINK_GPIO
            int "Blink GPIO number"
            range 0 48
            default 48
            help
                GPIO number (IOxx) to blink on and off or the RMT signal for the addressable LED.
                Some GPIOs are used for other purposes (flash connections, etc.) and cannot be used to blink.

        config BLINK_INVERTED
        	depends on BLINK_LED_GPIO
        	bool "Inverted"
            help
                lED anode to VCC

    endmenu

endmenu
```

## sdkconfig.defaults
```kconfig
# Default configurations

CONFIG_ESP_DEFAULT_CPU_FREQ_MHZ_240=y

CONFIG_ESPTOOLPY_FLASHSIZE_4MB=y
CONFIG_PARTITION_TABLE_CUSTOM=y
CONFIG_UNITY_ENABLE_COLOR=y

CONFIG_ESP_MAIN_TASK_STACK_SIZE=5120

# CONFIG_SPIRAM=y
# CONFIG_SPIRAM_MODE_OCT=y
# CONFIG_FATFS_LFN_HEAP=y
#CONFIG_ESP_CONSOLE_USB_SERIAL_JTAG=y
```

## sdkconfig.defaults.esp32s3
```kconfig
# Default configurations for ESP32-S3

#CONFIG_ESP32S3_DATA_CACHE_64KB=y
#CONFIG_ESP32S3_DATA_CACHE_8WAYS=y
#CONFIG_ESP32S3_DATA_CACHE_LINE_64B=y
```
